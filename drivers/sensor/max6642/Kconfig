## drivers/sensor/max6642/Kconfig
```kconfig
# MAX6642 temperature sensor config

# Copyright (c) 2021 Technosystem sp. z o.o.
# SPDX-License-Identifier: Apache-2.0

DT_COMPAT_MAX6642 := max6642

config MAX6642
	bool "MAX6642 Temperature Sensor"
	default $(dt_compat_enabled,$(DT_COMPAT_MAX6642))
	depends on I2C
	help
	  Enable the driver for the MAX6642 digital temperature Sensor with 2-wire
	  interface. Thermal watchdog is not implemented
```

## dts/bindings/sensor/max6642.yaml
```yaml
# Copyright (c) 2021 Technosystem sp. z o.o.
# SPDX-License-Identifier: Apache-2.0

description: MAX6642 Digital Temperature Sensor with 2-Wire Interface.

compatible: "max6642"

include: i2c-device.yaml
```
